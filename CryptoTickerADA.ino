//Vincent Rubens
//Cardano Stake Pool Operator
//Reaction Pool (XRX)
//Twitter: @vjrubens
//05 September 2021
//Cardano Ticker
//Thanks goes to Michael Klements for the troubleshooting support!
//Modified from Andrew Budziszek's original version "https://github.com/SonnyBrooks/bitcoin-ticker-esp32/blob/main/bitcoinTicker.ino"
//to include the Cardano logo and IO for the red and green indicator LEDs


#include <Adafruit_SSD1306.h>                                                 //Include the required libraries
#include <WiFi.h>
#include <Wire.h>
#include <HTTPClient.h>
#include <NTPClient.h> 
#include <WiFiUdp.h>
#include <ArduinoJson.h>

#define SCREEN_WIDTH 128                                                      //Define the OLED display width and height
#define SCREEN_HEIGHT 64
#define OLED_RESET     -1                                                     // Reset pin # (or -1 if sharing Arduino reset pin)
#define SCREEN_ADDRESS 0x3C                                                   //I2C address for display
#define upLED 13
#define downLED 12
Adafruit_SSD1306 display (SCREEN_WIDTH, SCREEN_HEIGHT, &Wire, OLED_RESET);    //Create the display object

const char* ssid = "WiFi Name Here";                                          //Set your WiFi network name and password
const char* password = "Enter Password";

const int httpsPort = 443;                                                    //Cardano price API powered by CoinDesk - https://www.coingecko.com/
const String url = "https://api.coingecko.com/api/v3/simple/price?ids=cardano&vs_currencies=usd&include_24hr_change=true";

WiFiClient client;                                                            //Create a new WiFi client
HTTPClient http;

String formattedDate;                                                         //Create variables to store the date and time
String dayStamp;
String timeStamp;

const unsigned char cardanoLogo[] PROGMEM = 
{
  0x00, 0x00, 0x00, 0x00, 0x00, 0x00, 0x00, 0x00, 0x00, 0x00, 0x00, 0x00, 0x00, 0x00, 0x00, 0x00, 
  0x00, 0x00, 0x00, 0x00, 0x00, 0x00, 0x00, 0x00, 0x00, 0x00, 0x00, 0x00, 0x00, 0x00, 0x00, 0x00, 
  0x00, 0x00, 0x00, 0x00, 0x00, 0x00, 0x00, 0x00, 0x00, 0x00, 0x00, 0x00, 0x00, 0x00, 0x00, 0x00, 
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  0x00, 0x00, 0x00, 0x00, 0x00, 0x00, 0x00, 0x00, 0x00, 0x00, 0x00, 0x00, 0x00, 0x00, 0x00, 0x00
};

void setup() 
{
  Serial.begin(115200);                                                        //Start the serial monitor
  
  pinMode(upLED, OUTPUT);                                                      //Define the LED pin outputs
  pinMode(downLED, OUTPUT);

  if (!display.begin(SSD1306_SWITCHCAPVCC, SCREEN_ADDRESS))                    //Connect to the display
  {
    Serial.println(F("SSD1306 allocation failed"));
    for (;;); // Don't proceed, loop forever
  }

  display.clearDisplay();                                                      //Clear the display
  display.setTextColor(SSD1306_WHITE);                                         //Set the text colour to white
  display.drawBitmap(0, 0, cardanoLogo, 128, 64, WHITE);                       //Display bitmap from array
  display.display();
  delay(2000);

  display.clearDisplay();                                                      //Clear the display
  display.setTextSize(1);                                                      //Set display parameters
  display.setTextColor(WHITE);
  display.println("Connecting to WiFi...");
  display.display();

  WiFi.begin(ssid, password);

  Serial.print("Connecting to WiFi...");
  while (WiFi.status() != WL_CONNECTED)                                        //Connect to the WiFi network
  {
    delay(500);
    Serial.print(".");
  }
  Serial.println();

  display.println("Connected to: ");                                           //Display message once connected
  display.print(ssid);
  display.display();
  delay(1500);
  display.clearDisplay();
  display.display();
}

void loop() 
{
  Serial.print("Connecting to ");                                              //Display url on Serial monitor for debugging
  Serial.println(url);

  http.begin(url);
  int httpCode = http.GET();                                                   //Get crypto price from API
  StaticJsonDocument<2000> doc;
  DeserializationError error = deserializeJson(doc, http.getString());

  if (error)                                                                   //Display error message if unsuccessful
  {
    Serial.print(F("deserializeJson Failed"));
    Serial.println(error.f_str());
    delay(2500);
    return;
  }

  Serial.print("HTTP Status Code: ");
  Serial.println(httpCode);

  String ADAUSDPrice = doc["cardano"]["usd"].as<String>();                     //Store crypto price and update date in local variables
  String percentChange = doc["cardano"]["usd_24h_change"].as<String>();
  percentChange.remove(4);                                                     //Adjust the decimal placement
  http.end();

  Serial.print("ADAUSD Price: ");                                              //Display current price on serial monitor

  bool isUp = percentChange > "0";                                             //Check whether price has increased or decreased
  String dayChangeString = "24hr. Change: "; 
  if (isUp)                                                                    //If price has increased from yesterday
  {
    percentChange >= "0";
    digitalWrite(upLED, HIGH);
    digitalWrite(downLED, LOW);
  } 
  else                                                                         //If price has decreased from yesterday
  {
    percentChange < "0";
    digitalWrite(downLED, HIGH);
    digitalWrite(upLED, LOW);
  }

  Serial.print("Percent Change: ");                                            //Display the percentage change on the serial monitor
  Serial.println(percentChange);

  display.clearDisplay();                                                      //Clear the OLED display
  display.setTextSize(1);
  printCenter("ADA/USD", 0, 0);                                                //Display the comparison header

  display.setTextSize(2);
  printCenter("$" + ADAUSDPrice, 0, 25);                                       //Display the current price

  display.setTextSize(1);                                                      //Display the change percentage
  dayChangeString = dayChangeString + percentChange + "%";
  printCenter(dayChangeString, 0, 55);
  display.display();                                                           //Execute the new display

  http.end();                                                                  //End the WiFi connection
  esp_sleep_enable_timer_wakeup(900000000);                                    //Sleep for 15 minutes
}

void printCenter(const String buf, int x, int y)                               //Function to centre the current price in the display width
{
  int16_t x1, y1;
  uint16_t w, h;
  display.getTextBounds(buf, x, y, &x1, &y1, &w, &h);                          //Calculate string width
  display.setCursor((x - w / 2) + (128 / 2), y);                               //Set cursor to print string in centre
  display.print(buf);                                                          //Display string
}
